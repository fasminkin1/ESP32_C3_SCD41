## build/Kconfig/arch/Kconfig.tmp
```kconfig
# Load Zephyr Arch Kconfig descriptions.
osource "/home/g/zephyrproject/zephyr/arch/rx/Kconfig"
osource "/home/g/zephyrproject/zephyr/arch/x86/Kconfig"
osource "/home/g/zephyrproject/zephyr/arch/xtensa/Kconfig"
osource "/home/g/zephyrproject/zephyr/arch/sparc/Kconfig"
osource "/home/g/zephyrproject/zephyr/arch/riscv/Kconfig"
osource "/home/g/zephyrproject/zephyr/arch/posix/Kconfig"
osource "/home/g/zephyrproject/zephyr/arch/openrisc/Kconfig"
osource "/home/g/zephyrproject/zephyr/arch/mips/Kconfig"
osource "/home/g/zephyrproject/zephyr/arch/arm64/Kconfig"
osource "/home/g/zephyrproject/zephyr/arch/arm/Kconfig"
osource "/home/g/zephyrproject/zephyr/arch/arc/Kconfig"
```

## build/Kconfig/boards/Kconfig.defconfig
```kconfig
# Load Zephyr board defconfig descriptions.
osource "/home/g/zephyrproject/zephyr/boards/01space/esp32c3_042_oled/Kconfig.defconfig"
```

## build/Kconfig/boards/Kconfig.sysbuild
```kconfig
# Load Sysbuild board Kconfig descriptions.
osource "/home/g/zephyrproject/zephyr/boards/01space/esp32c3_042_oled/Kconfig.sysbuild"
```
